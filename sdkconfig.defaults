## sdkconfig.defaults
```kconfig
CONFIG_ESP_TLS_INSECURE=y
CONFIG_ESP_TLS_SKIP_SERVER_CERT_VERIFY=y
CONFIG_MBEDTLS_CERTIFICATE_BUNDLE=n

# Flash — 16 MB chip
CONFIG_ESPTOOLPY_FLASHSIZE_16MB=y

# PSRAM — ESP32-S3-WROOM-1U-N16R8 (8 MB OPI PSRAM)
CONFIG_SPIRAM=y
CONFIG_SPIRAM_MODE_OCT=y
CONFIG_SPIRAM_SPEED_80M=y
CONFIG_SPIRAM_BOOT_INIT=y
CONFIG_SPIRAM_IGNORE_NOTFOUND=n
CONFIG_SPIRAM_USE_MALLOC=y
CONFIG_SPIRAM_MEMTEST=n
```
